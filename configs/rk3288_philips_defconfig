## configs/rk3288_philips_defconfig
```kconfig
CONFIG_SYS_EXTRA_OPTIONS="RKCHIP_RK3288,PRODUCT_MID,NORMAL_WORLD,SECOND_LEVEL_BOOTLOADER"
CONFIG_ARM=y
CONFIG_OF_CONTROL=y
CONFIG_OF_EMBED=y
CONFIG_DEFAULT_DEVICE_TREE="rk3288-philips"
CONFIG_ROCKCHIP_ARCH32=y
CONFIG_PLAT_RK32XX=y
# CONFIG_SYS_MALLOC_CLEAR_ON_INIT is not set
```
